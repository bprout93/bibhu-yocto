## oe-bibhu/meta-bibhu/conf/bblayers.conf.sample
```bitbake
# LAYER_CONF_VERSION is increased each time build/conf/bblayers.conf
# changes incompatibly
LCONF_VERSION = "6"

BBPATH = "${TOPDIR}"
BBFILES ?= ""
BBLAYERS ?= " \
  ##COREBASE##/oe-core/meta \
  ##COREBASE##/oe-bibhu/meta-bibhu \
  ##COREBASE##/oe-core/meta-yocto-bsp \
  ##COREBASE##/oe-core/meta-yocto \
  ##COREBASE##/oe-bibhu/meta-browser \
  ##COREBASE##/oe-core/meta-openembedded/meta-oe \
  "
```

## oe-bibhu/meta-bibhu/conf/layer.conf
```bitbake
# We have a conf and classes directory, add to BBPATH
BBPATH .= ":${LAYERDIR}"

# We have recipes-* directories, add to BBFILES
BBFILES += "${LAYERDIR}/recipes-*/*/*.bb \
	${LAYERDIR}/recipes-*/*/*.bbappend"

BBFILE_COLLECTIONS += "bibhu"
BBFILE_PATTERN_bibhu = "^${LAYERDIR}/"
BBFILE_PRIORITY_bibhu = "6"
```

## oe-bibhu/meta-bibhu/conf/machine/bbb.conf
```bitbake
#@TYPE: Machine
#@NAME: Beaglebone-yocto machine
#@DESCRIPTION: Reference machine configuration for http://beagleboard.org/bone and http://beagleboard.org/black boards

PREFERRED_PROVIDER_virtual/xserver ?= "xserver-xorg"
XSERVER ?= "xserver-xorg \
           xf86-video-modesetting \
           "
SOC_FAMILY = "am335x"
TARGET_ARCH = "arm"
# DEFAULTTUNE makes it possible to build for the ARM hardfloat ABI.
DEFAULTTUNE ?= "cortexa8hf-neon"

require conf/machine/include/soc-family.inc
require conf/machine/include/tune-cortexa8.inc

# Specify kernel recipe
PREFERRED_PROVIDER_virtual/kernel = "linux-bbb-system"

# Specify u-boot parameters
PREFERRED_PROVIDER_virtual/bootloader = "u-boot-bbb"
PREFERRED_PROVIDER_u-boot ?= "u-boot-bbb"
UBOOT_ENTRYPOINT = "0x80008000"
UBOOT_LOADADDRESS = "0x80008000"



# Default to external video, uncomment for LCD panels
# GUI_MACHINE_CLASS = "smallscreen"
GUI_MACHINE_CLASS ?= "bigscreen"

# For kernels older than 2.6.37, use "115200 ttyS2" instead
SERIAL_CONSOLES = "115200;ttyO1"
# tar.bz2 for SD card, UBI for nand
IMAGE_FSTYPES := "ext4 tar.bz2"

# Ship all kernel modules by default
MACHINE_EXTRA_RRECOMMENDS = " kernel-modules"
MACHINE_FEATURES = "serial"

# TI dsplink
TOOLCHAIN_PATH ?= "${STAGING_DIR_NATIVE}${prefix_native}/bin/${TUNE_PKGARCH}${HOST_VENDOR}-${HOST_OS}"
```

## oe-bibhu/meta-bibhu/conf/machine/bpA20.conf
```bitbake
#@TYPE: Machine
#@NAME: bpA20 machine
#@DESCRIPTION: Machine configuration for the Steelcase RW20

PREFERRED_PROVIDER_virtual/xserver ?= "xserver-xorg"
XSERVER ?= "xserver-xorg \
					  xf86-input-evdev \
						xf86-input-mouse \
						xf86-video-fbdev \
						xf86-input-keyboard"

SOC_FAMILY = "sun7i"
TARGET_ARCH = "arm"
# DEFAULTTUNE makes it possible to build for the ARM hardfloat ABI.
DEFAULTTUNE ?= "cortexa7hf-neon"

require conf/machine/include/soc-family.inc
require conf/machine/include/tune-cortexa7.inc

# Specify kernel recipe
PREFERRED_PROVIDER_virtual/kernel = "linux-bpA20-system"


# Specify u-boot parameters
PREFERRED_PROVIDER_virtual/bootloader = "u-boot-bpA20"
PREFERRED_PROVIDER_u-boot ?= "u-boot-bpA20"
UBOOT_ENTRYPOINT = "0x40008000"
UBOOT_LOADADDRESS = "0x40008000"



# Default to external video, uncomment for LCD panels
# GUI_MACHINE_CLASS = "smallscreen"
GUI_MACHINE_CLASS ?= "bigscreen"

SERIAL_CONSOLE = "115200 ttyS0 vt100"
# tar.bz2 for SD card, UBI for nand
IMAGE_FSTYPES := "ext4 tar.bz2"

# Ship all kernel modules by default
MACHINE_EXTRA_RRECOMMENDS = " kernel-modules"
MACHINE_FEATURES = "serial"

# TI dsplink
TOOLCHAIN_PATH ?= "${STAGING_DIR_NATIVE}${prefix_native}/bin/${TUNE_PKGARCH}${HOST_VENDOR}-${HOST_OS}"
```

## oe-bibhu/meta-bibhu/conf/machine/sama5d3.conf
```bitbake
#@TYPE: Machine
#@Name: ATMEL SAMA5D3 Xplained
#@DESCRIPTION: Machine configuration for Atmel's evaluation board
# Atmel SAMA5 defaults
require conf/machine/include/soc-family.inc
require conf/machine/include/tune-cortexa5.inc
SOC_FAMILY = "sama5"
PREFERRED_PROVIDER_virtual/kernel = "linux-sama5d3-system"
PREFERRED_PROVIDER_virtual/bootloader_sama5 ?= "u-boot-sama5d3"
PREFERRED_PROVIDER_jpeg ?= "jpeg"
PREFERRED_PROVIDER_jpeg-native ?= "jpeg-native"
# used by sysvinit_2
SOC_FAMILY = "sama5:sama5d3"
DEFAULTTUNE = "cortexa5thf"
SERIAL_CONSOLE ?= "115200 ttyS0"
MACHINE_FEATURES = "kernel26 apm alsa ext2 ext3 usbhost usbgadget screen camera can touchscreen ppp wifi"
KERNEL_DEVICETREE = " \
at91-sama5d3_xplained.dtb \
at91-sama5d3_xplained_pda4.dtb \
at91-sama5d3_xplained_pda7.dtb \
"
# used by sysvinit_2
SERIAL_CONSOLES ?= "115200;ttyS0 115200;ttyGS0"
ROOT_FLASH_SIZE = "256"
IMAGE_FSTYPES += " ubi tar.gz"
# NAND
MKUBIFS_ARGS ?= " -e 0x1f000 -c 2048 -m 0x800 -x lzo"
UBINIZE_ARGS ?= " -m 0x800 -p 0x20000 -s 2048"
UBI_VOLNAME = "rootfs"
UBOOT_MACHINE ?= "sama5d3_xplained_nandflash_config"
UBOOT_ENTRYPOINT = "0x20008000"
UBOOT_LOADADDRESS = "0x20008000"
AT91BOOTSTRAP_MACHINE ?= "sama5d3_xplained"
```
